## blink-rgb/main/Kconfig.projbuild
```kconfig
menu "Example Configuration"

    orsource "$IDF_PATH/examples/common_components/env_caps/$IDF_TARGET/Kconfig.env_caps"

    config GPIO_LED_RED
        int "Red LED GPIO number"
        range ENV_GPIO_RANGE_MIN ENV_GPIO_OUT_RANGE_MAX
        default 3
        help
            GPIO number (IOxx) to control red LED.

    config GPIO_LED_GREEN
        int "Green LED GPIO number"
        range ENV_GPIO_RANGE_MIN ENV_GPIO_OUT_RANGE_MAX
        default 4
        help
            GPIO number (IOxx) to control green LED.

    config GPIO_LED_BLUE
        int "Blue LED GPIO number"
        range ENV_GPIO_RANGE_MIN ENV_GPIO_OUT_RANGE_MAX
        default 5
        help
            GPIO number (IOxx) to control blue LED.

    config BLINK_PERIOD
        int "Blink period in ms"
        range 10 3600000
        default 1000
        help
            Define the blinking period in milliseconds.

endmenu
```

## blink-rgb/sdkconfig.defaults
```kconfig
# default target: ESP-C3-01M
CONFIG_IDF_TARGET_ARCH_RISCV=y
CONFIG_IDF_TARGET_ARCH="riscv"
CONFIG_IDF_TARGET="esp32c3"
CONFIG_IDF_TARGET_ESP32C3=y

# custom configuration: LEDs
CONFIG_ENV_GPIO_RANGE_MIN=0
CONFIG_ENV_GPIO_RANGE_MAX=19
CONFIG_ENV_GPIO_IN_RANGE_MAX=19
CONFIG_ENV_GPIO_OUT_RANGE_MAX=19
CONFIG_GPIO_LED_RED=3
CONFIG_GPIO_LED_GREEN=4
CONFIG_GPIO_LED_BLUE=5
CONFIG_BLINK_PERIOD=500
```

## cam-test/main/Kconfig.projbuild
```kconfig
menu "Example Configuration"

    config EXAMPLE_SCAN_LIST_SIZE
        int "Max size of scan list"
        range 0 20
        default 10
        help
            The size of array that will be used to retrieve the list of access points.

    config EXAMPLE_WIFI_SSID
        string "WiFi Access Point SSID"
        default "test"
        help
            Set WiFi AP SSID.

    config EXAMPLE_WIFI_PASS
        string "WiFi Access Point password"
        default "test"
        help
            Set WiFi AP password.

    config FLASH_LED_PIN
        int "Flash LED pin"
        range 0 10
        default 4
        help
            Flash LED pin number.

endmenu
```

## cam-test/sdkconfig.defaults
```kconfig
# default target: esp32cam
CONFIG_IDF_TARGET_ARCH_XTENSA=y
CONFIG_IDF_TARGET_ARCH="xtensa"
CONFIG_IDF_TARGET="esp32"
CONFIG_IDF_TARGET_ESP32=y

# custom options: wifi
CONFIG_EXAMPLE_SCAN_LIST_SIZE=10
CONFIG_EXAMPLE_WIFI_SSID="test"
CONFIG_EXAMPLE_WIFI_PASS="test"

# custom options: data partition on spi flash
CONFIG_PARTITION_TABLE_CUSTOM=y
CONFIG_PARTITION_TABLE_CUSTOM_FILENAME="storage.csv"
CONFIG_PARTITION_TABLE_FILENAME="storage.csv"

# httpd: increase request size to handle post 
CONFIG_HTTPD_MAX_REQ_HDR_LEN=1024

# esp32-camera requirements
CONFIG_SPIRAM_SUPPORT=y
CONFIG_ESP32_SPIRAM_SUPPORT=y
CONFIG_SPIRAM_SPEED_80M=y

# flash led pin
CONFIG_FLASH_LED_PIN=4
```

## fsm-rgb/main/Kconfig.projbuild
```kconfig
menu "Example Configuration"

    orsource "$IDF_PATH/examples/common_components/env_caps/$IDF_TARGET/Kconfig.env_caps"

    config GPIO_LED_RED
        int "Red LED GPIO number"
        range ENV_GPIO_RANGE_MIN ENV_GPIO_OUT_RANGE_MAX
        default 3
        help
            GPIO number (IOxx) to control red LED.

    config GPIO_LED_GREEN
        int "Green LED GPIO number"
        range ENV_GPIO_RANGE_MIN ENV_GPIO_OUT_RANGE_MAX
        default 4
        help
            GPIO number (IOxx) to control green LED.

    config GPIO_LED_BLUE
        int "Blue LED GPIO number"
        range ENV_GPIO_RANGE_MIN ENV_GPIO_OUT_RANGE_MAX
        default 5
        help
            GPIO number (IOxx) to control blue LED.

    config RED_TIME_MS
        int "Red LED time in ms"
        range 10 3600000
        default 10000
        help
            Define red LED time the in milliseconds.

    config GREEN_TIME_MS
        int "Green LED time in ms"
        range 10 3600000
        default 5000
        help
            Define green LED time the in milliseconds.

    config GREEN_FLASH_TIME_MS
        int "Green LED flash period in ms"
        range 10 3600000
        default 1000
        help
            Define green LED flash period in milliseconds.

    config GREEN_FLASH_COUNT
        int "Green LED flash count"
        range 1 100
        default 10
        help
            Define how many times green LED flashes before yellow light.

    config YELLOW_TIME_MS
        int "Yellow LED time in ms"
        range 10 3600000
        default 5000
        help
            Define yellow LED time the in milliseconds.

endmenu
```

## fsm-rgb/sdkconfig.defaults
```kconfig
# default target: ESP-C3-01M
CONFIG_IDF_TARGET_ARCH_RISCV=y
CONFIG_IDF_TARGET_ARCH="riscv"
CONFIG_IDF_TARGET="esp32c3"
CONFIG_IDF_TARGET_ESP32C3=y

# custom configuration: LEDs
CONFIG_ENV_GPIO_RANGE_MIN=0
CONFIG_ENV_GPIO_RANGE_MAX=19
CONFIG_ENV_GPIO_IN_RANGE_MAX=19
CONFIG_ENV_GPIO_OUT_RANGE_MAX=19
CONFIG_GPIO_LED_RED=3
CONFIG_GPIO_LED_GREEN=4
CONFIG_GPIO_LED_BLUE=5
CONFIG_RED_TIME_MS=5000
CONFIG_GREEN_TIME_MS=5000
CONFIG_GREEN_FLASH_TIME_MS=500
CONFIG_GREEN_FLASH_COUNT=6
CONFIG_YELLOW_TIME_MS=3000
```

## http-test/sdkconfig.defaults
```kconfig
# default target: Wemos Lolin32
CONFIG_IDF_TARGET_ARCH_XTENSA=y
CONFIG_IDF_TARGET_ARCH="xtensa"
CONFIG_IDF_TARGET="esp32"
CONFIG_IDF_TARGET_ESP32=y

# custom options: wifi
CONFIG_EXAMPLE_SCAN_LIST_SIZE=10
CONFIG_EXAMPLE_WIFI_SSID="test"
CONFIG_EXAMPLE_WIFI_PASS="test"
```

## i2s-sine/main/Kconfig.projbuild
```kconfig
menu "Example Configuration"

    config TBD_NUMBER
        int "TBD number"
        range 0 9
        default 5
        help
            TBD number

    config TBD_STRING
        string "TBD string"
        default "TBD"
        help
            TBD string

endmenu
```

## i2s-wav/sdkconfig.defaults
```kconfig
# default target: Wemos Lolin32
CONFIG_IDF_TARGET_ARCH_XTENSA=y
CONFIG_IDF_TARGET_ARCH="xtensa"
CONFIG_IDF_TARGET="esp32"
CONFIG_IDF_TARGET_ESP32=y

# esp32 i2s configuration: TODO

# custom configuration: TODO
```

## mqtt-test/main/Kconfig.projbuild
```kconfig
menu "Example Configuration"

    config EXAMPLE_SCAN_LIST_SIZE
        int "Max size of scan list"
        range 0 20
        default 10
        help
            The size of array that will be used to retrieve the list of access points.

    config EXAMPLE_WIFI_SSID
        string "WiFi Access Point SSID"
        default "test"
        help
            Set WiFi AP SSID.

    config EXAMPLE_WIFI_PASS
        string "WiFi Access Point password"
        default "test"
        help
            Set WiFi AP password.

    config EXAMPLE_BROKER_URL
        string "Broker URL"
        default "mqtt://192.168.88.254"
        help
            URL of the MQTT broker to connect to

    config EXAMPLE_GPIO_INPUT
        int "GPIO input pin"
        range 0 10
        default 9
        help
            GPIO pin number to be used as GPIO_INPUT_IO.

endmenu
```

## wifi-test/sdkconfig.defaults
```kconfig
# default target: ESP-C3-01M
CONFIG_IDF_TARGET_ARCH_RISCV=y
CONFIG_IDF_TARGET_ARCH="riscv"
CONFIG_IDF_TARGET="esp32c3"
CONFIG_IDF_TARGET_ESP32C3=y

# custom options: wifi
CONFIG_EXAMPLE_SCAN_LIST_SIZE=10
CONFIG_EXAMPLE_WIFI_SSID="test"
CONFIG_EXAMPLE_WIFI_PASS="test"

# custom options: mqtt broker url
CONFIG_EXAMPLE_BROKER_URL="mqtt://192.168.88.254"

# custom options: button
CONFIG_EXAMPLE_GPIO_INPUT=9
```
